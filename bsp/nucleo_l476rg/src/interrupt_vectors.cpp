#include "mcu.hpp"
#include "board.hpp"
#include BSP_LL_DMA_HEADER

/**
 * @brief Handles interrupts generated by EXTI lines 10 through 15.
 *
 * Forwards the interrupt to the NUCLEO-L476RG user-button EXTI handler.
 */
extern "C" void EXTI15_10_IRQHandler(void) {
    bsp::board::detail::
        handle_user_button_exti();
}

extern "C" void DMA1_Channel2_IRQHandler() {
    // SPI1 RX DMA transfer complete.
    if (LL_DMA_IsActiveFlag_TC2(DMA1) != 0U) {
        LL_DMA_ClearFlag_TC2(DMA1);
        bsp::board::detail::handle_spi1_receive_dma_complete();
    }
    // SPI1 RX DMA transfer error.
    if (LL_DMA_IsActiveFlag_TE2(DMA1) != 0U) {
        LL_DMA_ClearFlag_TE2(DMA1);
        bsp::board::detail::handle_spi1_dma_error();
    }
}

extern "C" void DMA1_Channel3_IRQHandler() {
    // SPI1 TX DMA transfer complete.
    if (LL_DMA_IsActiveFlag_TC3(DMA1) != 0U) {
        LL_DMA_ClearFlag_TC3(DMA1);
        bsp::board::detail::handle_spi1_transmit_dma_complete();
    }
    // SPI1 TX DMA transfer error.
    if (LL_DMA_IsActiveFlag_TE3(DMA1) != 0U) {
        LL_DMA_ClearFlag_TE3(DMA1);
        bsp::board::detail::handle_spi1_dma_error();
    }
}

extern "C" void DMA1_Channel7_IRQHandler() {
    if (LL_DMA_IsActiveFlag_TC7(DMA1) != 0U) {
        LL_DMA_ClearFlag_TC7(DMA1);
        bsp::board::detail::handle_console_transmit_dma_complete();
    }

    if (LL_DMA_IsActiveFlag_TE7(DMA1) != 0U) {
        LL_DMA_ClearFlag_TE7(DMA1);
        bsp::board::detail::handle_console_transmit_dma_error();
    }
}